## conf/layer.conf
```bitbake
# Layer configuration for meta-bolide
# Standalone apps for AsteroidOS watches

BBPATH .= ":${LAYERDIR}"

BBFILES += " \
    ${LAYERDIR}/recipes-*/*/*.bb \
    ${LAYERDIR}/recipes-*/*/*.bbappend \
"

BBFILE_COLLECTIONS += "meta-bolide"
BBFILE_PATTERN_meta-bolide = "^${LAYERDIR}/"
BBFILE_PRIORITY_meta-bolide = "10"

LAYERDEPENDS_meta-bolide = "core"
LAYERSERIES_COMPAT_meta-bolide = "walnascar"

# Mask upstream recipes that bolide replaces or that have broken SRCREVs
BBMASK += "meta-asteroid/recipes-asteroid/asteroid-powerd"
BBMASK += "meta-asteroid/recipes-asteroid/asteroid-apps/asteroid-workout"
```
